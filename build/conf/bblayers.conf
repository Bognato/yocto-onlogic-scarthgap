## build/conf/bblayers.conf
```bitbake
# POKY_BBLAYERS_CONF_VERSION is increased each time build/conf/bblayers.conf
# changes incompatibly
POKY_BBLAYERS_CONF_VERSION = "2"

BBPATH = "${TOPDIR}"
BBFILES ?= ""

BBLAYERS ?= " \
  /home/bognato/Dev/yocto_from_scratch/poky/meta \
  /home/bognato/Dev/yocto_from_scratch/poky/meta-poky \
  /home/bognato/Dev/yocto_from_scratch/poky/meta-yocto-bsp \
  /home/bognato/Dev/yocto_from_scratch/meta-openembedded/meta-oe \
  /home/bognato/Dev/yocto_from_scratch/meta-swupdate \
  "
```

## meta-onlogic/conf/layer.conf
```bitbake
# Layer configuration for meta-onlogic
BBPATH := "${BBPATH}:${LAYERDIR}"
BBFILES += "${LAYERDIR}/recipes-*/*/*.bb \
            ${LAYERDIR}/recipes-*/*/*.bbappend"

BBFILE_COLLECTIONS += "meta-onlogic"
BBFILE_PRIORITY_meta-onlogic = "6"
LAYERVERSION_meta-onlogic = "1"
```
